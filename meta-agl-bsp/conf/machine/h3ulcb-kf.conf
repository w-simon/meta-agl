## meta-agl-bsp/conf/machine/h3ulcb-kf.conf
```bitbake
#Keep this as a reminder
#MACHINEOVERRIDES .= ":kingfisher"
#PACKAGE_EXTRA_ARCHS_append = " kingfisher"

# derivative of h3ulcb
require conf/machine/h3ulcb.conf
#


#
PREFERRED_RPROVIDER_virtual/gpsd-conf ?= "gpsd-kingfisher-conf"

# Radio packages
MACHINE_EXTRA_RDEPENDS += " \
    si-tools \
    si-init \
    linux-firmware-wl18xx \
    ti-bt \
    ti-bt-firmware \
"
```

## meta-agl-bsp/conf/machine/m3ulcb-kf.conf
```bitbake
#Keep this as a reminder
#MACHINEOVERRIDES .= ":kingfisher"
#PACKAGE_EXTRA_ARCHS_append = " kingfisher"

# derivative of m3ulcb
require conf/machine/m3ulcb.conf

# board specific gps configuration
PREFERRED_RPROVIDER_virtual/gpsd-conf ?= "gpsd-kingfisher-conf"

# Radio packages
MACHINE_EXTRA_RDEPENDS += " \
    si-tools \
    si-init \
    linux-firmware-wl18xx \
    ti-bt \
    ti-bt-firmware \
"
```

## meta-agl-bsp/meta-rcar-gen3-adas/conf/layer.conf
```bitbake
# We have a conf and classes directory, append to BBPATH
BBPATH .= ":${LAYERDIR}"

# We have a recipes directory, add to BBFILES
BBFILES += " \
    ${LAYERDIR}/../../../bsp/meta-rcar/meta-rcar-gen3-adas/recipes-*/*/*.bb \
    ${LAYERDIR}/../../../bsp/meta-rcar/meta-rcar-gen3-adas/recipes-*/*/*.bbappend \
    ${LAYERDIR}/recipes-*/*/*.bb \
    ${LAYERDIR}/recipes-*/*/*.bbappend \
"

BBFILE_COLLECTIONS += "rcar-gen3-cogent"
BBFILE_PATTERN_rcar-gen3-cogent := "^${LAYERDIR}/../../../bsp/meta-rcar/meta-rcar-gen3-adas/"
BBFILE_PRIORITY_rcar-gen3-cogent = "7"

LAYERSERIES_COMPAT_rcar-gen3-cogent = "dunfell"

# should be MACHINE FEATURE OR OTHER INCLUSION MECHANISM. *NOT* IN LAYER.conf !!
# Radio packages
#IMAGE_INSTALL_append_rcar-gen3 += " \
#    si-tools \
#    si-init \
#    linux-firmware-wl18xx \
#    ti-bt \
#    ti-bt-firmware \
#    bluez5 \
#    bluez5-testtools \
#    ofono \
#    ofono-tests \
#"

# IMP  ---> MACHINE FEATURE. NOT IN LAYER.CONF !!
#IMAGE_INSTALL_append_r8a7797 += " \
#    kernel-module-uio-imp \
#    kernel-module-cmemdrv \
#    udev-rules-cvlib \
#"

# MACHINE FEATURE. NOT IN LAYER.CONF !!
#IMAGE_INSTALL_append_r8a7798 += " \
#    kernel-module-uio-imp \
#    kernel-module-cmemdrv \
#    udev-rules-cvlib \
#"

# SPECIAL USE CASE. MOVE TO IMAGE_FEATURE OR MACHINE_FEATURE, NOT DISTRO_FEATURE.
#DISTRO_FEATURES_append = " surroundview "

# NOT IN LAYER.CONF
#DISTRO_FEATURES_append = " bluetooth"

# NO NOT CHANGE SYSTEMD !!
BBMASK += "/meta-rcar-gen3-adas/recipes-core/systemd/"

# NO OPENCV beside upstream
BBMASK += "/meta-rcar-gen3-adas/recipes-graphics/opencv/"

# not required for AGL
BBMASK += "/meta-rcar-gen3-adas/recipes-benchmark/"

# NONE of the boards in there is used in AGL
BBMASK += "/meta-rcar-gen3-adas/recipes-bsp/arm-trusted-firmware/"

# DO NOT CHANGE bluez package
BBMASK += "/meta-rcar-gen3-adas/recipes-connectivity/bluez/"

# DO NOT CHANGE *core* images !!
BBMASK += "/meta-rcar-gen3-adas/recipes-core/images/"
BBMASK += "/meta-rcar-gen3-adas/recipes-core/packagegroups/nativesdk-packagegroup-sdk-host.bbappend"

# DO NOT PATCH CMAKE ... 
BBMASK += "/meta-rcar-gen3-adas/recipes-devtools/"

# DO NOT PATCH valgrind
BBMASK += "/meta-rcar-gen3-adas/recipes-devtools/valgrind/"

# DO NOT PATCH gcc-sanitizers
BBMASK += "/meta-rcar-gen3-adas/recipes-devtools/gcc/"

BBMASK += "/meta-rcar-gen3-adas/recipes-graphics/libpng/"
BBMASK += "/meta-rcar-gen3-adas/recipes-graphics/wayland/"

# NOTHING WE NEED
BBMASK += "/meta-rcar-gen3-adas/recipes-support/"

# NOTHING WE NEED
BBMASK += "/meta-rcar-gen3-adas/recipes-multimedia/gstreamer/"
BBMASK += "/meta-rcar-gen3-adas/recipes-multimedia/pulseaudio/"
```

## meta-agl-core/conf/distro/poky-agl-core.conf
```bitbake
require conf/distro/poky.conf

# AGL specific derivations
DISTRO = "poky-agl-core"
DISTRO_NAME = "Automotive Grade Linux Core"

# Release flags
DISTRO_CODENAME = "lamprey-core"
AGL_BRANCH = "master"
AGLVERSION = "11.90.0"

# switch  devel/release
AGLRELEASETYPE ?= "agldevelopment"
#AGLRELEASETYPE ?= "aglrelease"
OVERRIDES .= ":${AGLRELEASETYPE}"
#

#for development
DISTRO_VERSION_agldevelopment := "${AGLVERSION}+snapshot-${DATE}"
AGL_APP_REVISION_agldevelopment = "${AUTOREV}"
AGL_DEFAULT_REVISION_agldevelopment = "${AUTOREV}"

#for release
DISTRO_VERSION_aglrelease := "${AGLVERSION}"
DISTRO_BRANCH_VERSION_TAG = "${DISTRO_CODENAME}/${@'${DISTRO_VERSION}'.replace('+snapshot-${DATE}','')}"
AGL_APP_REVISION_aglrelease := "refs/tags/${DISTRO_BRANCH_VERSION_TAG}"
AGL_DEFAULT_REVISION_aglrelease := "refs/tags/${DISTRO_BRANCH_VERSION_TAG}"

# reproducible builds:
# enable the flag
BUILD_REPRODUCIBLE_BINARIES = "1"
# Set the desired timestamps
export SOURCE_DATE_EPOCH = "1593400000"
REPRODUCIBLE_TIMESTAMP_ROOTFS = "1593400000"
# inherit the class
INHERIT += "reproducible_build"

# SDK
SDK_VENDOR = "-aglsdk"
SDK_VERSION := "${@'${DISTRO_VERSION}'.replace('snapshot-${DATE}','snapshot')}"

# SDKPATH is the folder where the SDK is going to be installed
# Due to an issue with the qt5 environment (see SPEC-1667),
# we add DEFAULTTUNE to the SDKPATH to mitigate the issue.
SDKPATH = "/opt/agl-sdk/${SDK_VERSION}-${DEFAULTTUNE}"

MAINTAINER = "AGL https://lists.automotivelinux.org/g/agl-dev-community"

TARGET_VENDOR = "-agl"

# Override these in poky based distros
AGL_DEFAULT_DISTRO_FEATURES = "systemd opengl wayland pam polkit"
POKY_DEFAULT_DISTRO_FEATURES := "${AGL_DEFAULT_DISTRO_FEATURES}"
OVERRIDES .= ":${DISTRO_CODENAME}"

# Need to fix: Mirrors are commentouted
#MIRRORS =+ "\
#bzr://.*/.*      https://download.automotivelinux.org/AGL/mirror/ \n \
#cvs://.*/.*      https://download.automotivelinux.org/AGL/mirror/ \n \
#git://.*/.*      https://download.automotivelinux.org/AGL/mirror/ \n \
#gitsm://.*/.*    https://download.automotivelinux.org/AGL/mirror/ \n \
#hg://.*/.*       https://download.automotivelinux.org/AGL/mirror/ \n \
#osc://.*/.*      https://download.automotivelinux.org/AGL/mirror/ \n \
#p4://.*/.*       https://download.automotivelinux.org/AGL/mirror/ \n \
#svn://.*/.*      https://download.automotivelinux.org/AGL/mirror/ \n \
#bzr://.*/.*      http://download.automotivelinux.org/AGL/mirror/  \n \
#cvs://.*/.*      http://download.automotivelinux.org/AGL/mirror/  \n \
#git://.*/.*      http://download.automotivelinux.org/AGL/mirror/  \n \
#gitsm://.*/.*    http://download.automotivelinux.org/AGL/mirror/  \n \
#hg://.*/.*       http://download.automotivelinux.org/AGL/mirror/  \n \
#osc://.*/.*      http://download.automotivelinux.org/AGL/mirror/  \n \
#p4://.*/.*       http://download.automotivelinux.org/AGL/mirror/  \n \
#svn://.*/.*      http://download.automotivelinux.org/AGL/mirror/  \n \
#                 \
#ftp://.*/.*      https://download.automotivelinux.org/AGL/mirror/ \n \
#http://.*/.*     https://download.automotivelinux.org/AGL/mirror/ \n \
#https://.*/.*    https://download.automotivelinux.org/AGL/mirror/ \n \
#ftp://.*/.*      http://download.automotivelinux.org/AGL/mirror/  \n \
#http://.*/.*     http://download.automotivelinux.org/AGL/mirror/  \n \
#https://.*/.*    http://download.automotivelinux.org/AGL/mirror/  \n \
#"

# The CONNECTIVITY_CHECK_URI's are used to test whether we can succesfully
# fetch from the network (and warn you if not). To disable the test set
# the variable to be empty.
# Git example url: git://git.yoctoproject.org/yocto-firewall-test;protocol=git;rev=HEAD
CONNECTIVITY_CHECK_URIS ?= ""

PREFERRED_PROVIDER_udev ?= "systemd"
PREFERRED_PROVIDER_udev-utils ?= "systemd"

VIRTUAL-RUNTIME_init_manager = "systemd"
VIRTUAL-RUNTIME_initscripts = ""

# network manager to use (possible values: systemd, connman)
VIRTUAL-RUNTIME_net_manager = "systemd" 

DISTRO_FEATURES_append = " "
DISTRO_FEATURES_remove = "x11"
DISTRO_FEATURES_BACKFILL_CONSIDERED = "sysvinit"

# using multiple BSP layers causes dangling bbappends in meta-agl-bsp
# turn it into a warning
#BB_DANGLINGAPPENDS_WARNONLY = "1"
```

## meta-agl-host/conf/layer.conf
```bitbake
# We have a conf and classes directory, add to BBPATH
BBPATH =. "${LAYERDIR}:"

# We have recipes-* directories, add to BBFILES
BBFILES += "${LAYERDIR}/recipes-*/*/*.bb \
            ${LAYERDIR}/recipes-*/*/*.bbappend"

BBFILE_COLLECTIONS += "aglhost"
BBFILE_PATTERN_aglhost = "^${LAYERDIR}/"
BBFILE_PRIORITY_aglhost = "60"

LAYERSERIES_COMPAT_aglhost = "dunfell"
LAYERDEPENDS_aglhost = "aglcore"

# Sanity check for meta-virtualization layer.
# Setting SKIP_META_VIRT_SANITY_CHECK to "1" would skip the bbappend files check.
#INHERIT += "sanity-meta-agl-ic"
```

## meta-agl-ic/conf/layer.conf
```bitbake
# We have a conf and classes directory, add to BBPATH
BBPATH =. "${LAYERDIR}:"

# We have recipes-* directories, add to BBFILES
BBFILES += "${LAYERDIR}/recipes-*/*/*.bb \
            ${LAYERDIR}/recipes-*/*/*.bbappend"

BBFILE_COLLECTIONS += "aglic"
BBFILE_PATTERN_aglic = "^${LAYERDIR}/"
BBFILE_PRIORITY_aglic = "60"

LAYERSERIES_COMPAT_aglic = "dunfell"
LAYERDEPENDS_aglic = "aglcore"

# Sanity check for meta-virtualization layer.
# Setting SKIP_META_VIRT_SANITY_CHECK to "1" would skip the bbappend files check.
#INHERIT += "sanity-meta-agl-ic"
```

## meta-agl-profile-graphical-qt5-html5/conf/layer.conf
```bitbake
# We have a conf and classes directory, add to BBPATH
BBPATH =. "${LAYERDIR}:"

# We have recipes-* directories, add to BBFILES
BBFILES += "${LAYERDIR}/recipes-*/*/*.bb \
            ${LAYERDIR}/recipes-*/*/*.bbappend"

BBFILE_COLLECTIONS += "aglprofilegraphicalqt5html5"
BBFILE_PATTERN_aglprofilegraphicalqt5html5 = "^${LAYERDIR}/"
BBFILE_PRIORITY_aglprofilegraphicalqt5html5 = "70"
```

## meta-agl-profile-ivi/conf/layer.conf
```bitbake
# We have a conf and classes directory, add to BBPATH
BBPATH =. "${LAYERDIR}:"

# We have recipes-* directories, add to BBFILES
BBFILES += "${LAYERDIR}/recipes-*/*/*.bb \
            ${LAYERDIR}/recipes-*/*/*.bbappend"

BBFILE_COLLECTIONS += "aglprofileivi"
BBFILE_PATTERN_aglprofileivi = "^${LAYERDIR}/"
BBFILE_PRIORITY_aglprofileivi = "80"

LAYERSERIES_COMPAT_aglprofileivi = "dunfell"
```
